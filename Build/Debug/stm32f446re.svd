# STM32F446 register map
File version: 1.1
CPU: CM4 r1p0, little endian, no MPU, no FPU, 3 interrupt priority bits
Registers are 32-bit, read-write, reset 0x0 unless marked. A register's access mark holds for its fields unless they carry their own. Offsets are from the block's base; lines under a group give offsets from that group; [hi:lo] are bit positions; {n}, {i} and the like mark numbered series; 'fields as' and 'values as' point back to an identical list; <NAME> marks a mode.

## Memory map
0x40000000 TIM2 size 0x400 — General purpose timers
0x40000400 TIM3 size 0x400 — General purpose timers
0x40000800 TIM4 size 0x400
0x40000C00 TIM5 size 0x400 — General-purpose-timers
0x40001000 TIM6 size 0x400 — Basic timers
0x40001400 TIM7 size 0x400
0x40001800 TIM12 size 0x400
0x40001C00 TIM13 size 0x400
0x40002000 TIM14 size 0x400
0x40002800 RTC size 0x400 — Real-time clock
0x40002C00 WWDG size 0x400 — Window watchdog
0x40003000 IWDG size 0x400 — Independent watchdog
0x40003800 SPI2 size 0x400
0x40003C00 SPI3 size 0x400
0x40004000 SPDIF_RX size 0x400 — Receiver Interface
0x40004400 USART2 size 0x400
0x40004800 USART3 size 0x400
0x40004C00 UART4 size 0x400 — Universal synchronous asynchronous receiver transmitter
0x40005000 UART5 size 0x400
0x40005400 I2C1 size 0x400
0x40005800 I2C2 size 0x400
0x40005C00 I2C3 size 0x400 — Inter-integrated circuit
0x40006400 CAN1 size 0x400 — Controller area network
0x40006800 CAN2 size 0x400
0x40006C00 HDMI_CEC size 0x400 — HDMI-CEC controller
0x40007000 PWR size 0x400 — Power control
0x40007400 DAC size 0x400 — Digital-to-analog converter
0x40010000 TIM1 size 0x400 — Advanced-timers
0x40010400 TIM8 size 0x400
0x40011000 USART1 size 0x400
0x40011400 USART6 size 0x400 — Universal synchronous asynchronous receiver transmitter
0x40012000 ADC1 size 0x51 — Analog-to-digital converter
0x40012100 ADC2 size 0x51
0x40012200 ADC3 size 0x51
0x40012300 C_ADC size 0xD — Common ADC registers
0x40012C00 SDMMC size 0x3FD
0x40013000 SPI1 size 0x400 — Serial peripheral interface
0x40013400 SPI4 size 0x400
0x40013800 SYSCFG size 0x400 — System configuration controller
0x40013C00 EXTI size 0x400 — External interrupt/event controller
0x40014000 TIM9 size 0x400 — General purpose timers
0x40014400 TIM10 size 0x400 — General-purpose-timers
0x40014800 TIM11 size 0x400 — General-purpose-timers
0x40015800 SAI1 size 0x400 — Serial audio interface
0x40015C00 SAI2 size 0x400
0x40020000 GPIOA size 0x400 — General-purpose I/Os
0x40020400 GPIOB size 0x400 — General-purpose I/Os
0x40020800 GPIOC size 0x400
0x40020C00 GPIOD size 0x400
0x40021000 GPIOE size 0x400
0x40021400 GPIOF size 0x400
0x40021800 GPIOG size 0x400
0x40021C00 GPIOH size 0x400 — General-purpose I/Os
0x40023000 CRC size 0x400 — Cryptographic processor
0x40023800 RCC size 0x400 — Reset and clock control
0x40023C00 FLASH size 0x400
0x40026000 DMA1 size 0x400
0x40026400 DMA2 size 0x400 — DMA controller
0x40040000 OTG_HS_GLOBAL size 0x400 — USB on the go high speed
0x40040400 OTG_HS_HOST size 0x400 — USB on the go high speed
0x40040800 OTG_HS_DEVICE size 0x400 — USB on the go high speed
0x40040E00 OTG_HS_PWRCLK size 0x3F200 — USB on the go high speed
0x50000000 OTG_FS_GLOBAL size 0x400 — USB on the go full speed
0x50000400 OTG_FS_HOST size 0x400 — USB on the go full speed
0x50000800 OTG_FS_DEVICE size 0x400 — USB on the go full speed
0x50000E00 OTG_FS_PWRCLK size 0x400 — USB on the go full speed
0x50050000 DCMI size 0x400 — Digital camera interface
0xA0000000 FMC size 0x400 — Flexible memory controller
0xA0001000 QUADSPI size 0x400 — QuadSPI interface
0xE000E008 SCB_ACTRL size 0x5 — System control block ACTLR
0xE000E010 STK size 0x11 — SysTick timer
0xE000E100 NVIC size 0x355 — Nested Vectored Interrupt Controller
0xE000ED00 SCB size 0x41 — System control block
0xE000ED88 FPU_CPACR size 0x5 — Floating point unit CPACR
0xE000ED90 MPU size 0x15 — Memory protection unit
0xE000EF00 NVIC_STIR size 0x5 — Nested vectored interrupt controller
0xE000EF34 FPU size 0xD — Floting point unit
0xE0042000 DBG size 0x400 — Debug support

## Interrupts
0 WWDG (UART4) — Window Watchdog interrupt
2 TAMP_STAMP (PWR) — Tamper and TimeStamp interrupts through the EXTI line
3 RTC_WKUP (UART5) — RTC Wakeup interrupt through the EXTI line
4 FLASH (SAI2) — Flash global interrupt
5 RCC — RCC global interrupt
6 EXTI0 (PWR) — EXTI Line0 interrupt
7 EXTI1 (PWR) — EXTI Line1 interrupt
8 EXTI2 (PWR) — EXTI Line2 interrupt
9 EXTI3 (PWR) — EXTI Line3 interrupt
10 EXTI4 (PWR) — EXTI Line4 interrupt
11 DMA1_Stream0 (DMA1) — DMA1 Stream0 global interrupt
12 DMA1_Stream1 (DMA1) — DMA1 Stream1 global interrupt
13 DMA1_Stream2 (DMA1) — DMA1 Stream2 global interrupt
14 DMA1_Stream3 (DMA1) — DMA1 Stream3 global interrupt
15 DMA1_Stream4 (DMA1) — DMA1 Stream4 global interrupt
16 DMA1_Stream5 (DMA1) — DMA1 Stream5 global interrupt
17 DMA1_Stream6 (DMA1) — DMA1 Stream6 global interrupt
18 ADC (ADC{n} (n=1..3)) — ADC1 global interrupt
19 CAN1_TX (OTG_HS_HOST) — CAN1 TX interrupts
20 CAN1_RX0 (OTG_HS_HOST) — CAN1 RX0 interrupts
21 CAN1_RX1 (OTG_HS_HOST) — CAN1 RX1 interrupts
22 CAN1_SCE (OTG_HS_HOST) — CAN1 SCE interrupt
23 EXTI9_5 (PWR) — EXTI Line[9:5] interrupts
24 TIM1_BRK_TIM9 (TIM10) — TIM1 Break interrupt and TIM9 global interrupt
25 TIM1_UP_TIM10 (TIM14) — TIM1 Update interrupt and TIM10 global interrupt
26 TIM1_TRG_COM_TIM11 (TIM7) — TIM1 Trigger and Commutation interrupts and TIM11 global interrupt
27 TIM1_CC (TIM2) — TIM1 Capture Compare interrupt
28 TIM2 (TIM4) — TIM2 global interrupt
29 TIM3 (TIM5) — TIM3 global interrupt
30 TIM4 (TIM9) — TIM4 global interrupt
31 I2C1_EV (WWDG) — I2C1 event interrupt
32 I2C1_ER (WWDG) — I2C1 error interrupt
33 I2C2_EV (IWDG) — I2C2 event interrupt
34 I2C2_ER (IWDG) — I2C2 error interrupt
35 SPI1 — SPI1 global interrupt
36 SPI2 — SPI2 global interrupt
37 USART1 — USART1 global interrupt
38 USART2 — USART2 global interrupt
39 USART3 — USART3 global interrupt
40 EXTI15_10 (PWR) — EXTI Line[15:10] interrupts
41 RTC_Alarm (UART5) — RTC Alarms (A and B) through EXTI line interrupt
42 OTG_FS_WKUP (NVIC) — USB On-The-Go FS Wakeup through EXTI line interrupt
43 TIM8_BRK_TIM12 (TIM13) — TIM8 Break interrupt and TIM12 global interrupt
44 TIM8_UP_TIM13 (TIM3) — TIM8 Update interrupt and TIM13 global interrupt
45 TIM8_TRG_COM_TIM14 (TIM3) — TIM8 Trigger and Commutation interrupts and TIM14 global interrupt
46 TIM8_CC (TIM3) — TIM8 Capture Compare interrupt
47 DMA1_Stream7 (DMA1) — DMA1 Stream7 global interrupt
48 FMC — FMC global interrupt
50 TIM5 (TIM12) — TIM5 global interrupt
51 SPI3 — SPI3 global interrupt
52 UART4 (C_ADC) — UART4 global interrupt
53 UART5 (TIM1) — UART5 global interrupt
54 TIM6_DAC (CRC) — TIM6 global interrupt, DAC1 and DAC2 underrun error interrupt
55 TIM7 (OTG_FS_GLOBAL) — TIM7 global interrupt
56 DMA2_Stream0 (DMA2) — DMA2 Stream0 global interrupt
57 DMA2_Stream1 (DMA2) — DMA2 Stream1 global interrupt
58 DMA2_Stream2 (DMA2) — DMA2 Stream2 global interrupt
59 DMA2_Stream3 (DMA2) — DMA2 Stream3 global interrupt
60 DMA2_Stream4 (DMA2) — DMA2 Stream4 global interrupt
61 ETH (OTG_FS_HOST) — Ethernet global interrupt
62 ETH_WKUP (OTG_FS_HOST) — Ethernet Wakeup through EXTI line interrupt
63 CAN2_TX (OTG_HS_DEVICE) — CAN2 TX interrupts
64 CAN2_RX0 (OTG_HS_DEVICE) — CAN2 RX0 interrupts
65 CAN2_RX1 (OTG_HS_DEVICE) — CAN2 RX1 interrupts
66 CAN2_SCE (OTG_HS_DEVICE) — CAN2 SCE interrupt
67 OTG_FS (NVIC) — USB On The Go FS global interrupt
68 DMA2_Stream5 (DMA2) — DMA2 Stream5 global interrupt
69 DMA2_Stream6 (DMA2) — DMA2 Stream6 global interrupt
70 DMA2_Stream7 (DMA2) — DMA2 Stream7 global interrupt
71 USART6 — USART6 global interrupt
72 I2C3_EV (I2C1) — I2C3 event interrupt
73 I2C3_ER (I2C1) — I2C3 error interrupt
78 DCMI — DCMI global interrupt
81 FPU — Floating point unit interrupt
82 UART7 (DAC) — UART 7 global interrupt
83 UART8 (I2C3) — UART 8 global interrupt
84 SPI4 — SPI 4 global interrupt
88 LCD_TFT (QUADSPI) — LTDC global interrupt
89 LCD_TFT_1 (QUADSPI) — LTDC global error interrupt
